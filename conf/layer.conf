## conf/layer.conf
```bitbake
BBPATH .= ":${LAYERDIR}"

BBFILES += "${LAYERDIR}/recipes-*/*/*.bb \
            ${LAYERDIR}/recipes-*/*/*.bbappend"

BBFILE_COLLECTIONS += "wpeqt"
BBFILE_PATTERN_wpeqt = "^${LAYERDIR}/"
BBFILE_PRIORITY_wpeqt = "8"

LAYERDEPENDS_wpeqt = "core qt6-layer watermelon-wine"
LAYERSERIES_COMPAT_wpeqt = "scarthgap"
```
